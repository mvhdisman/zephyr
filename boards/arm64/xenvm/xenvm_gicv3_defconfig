## boards/arm64/xenvm/xenvm_gicv3_defconfig
```kconfig
CONFIG_SOC_XENVM=y
CONFIG_BOARD_XENVM=y

# Use GICv3
CONFIG_XENVM_USE_GIC_V3=y

# Enable UART driver
CONFIG_SERIAL=y

CONFIG_MAX_XLAT_TABLES=10

# Enable console
CONFIG_CONSOLE=y
CONFIG_UART_CONSOLE=y

# Enable PV hypervisor console
CONFIG_UART_XEN_HVC=y

# Enable logging subsys
CONFIG_LOG=y
CONFIG_LOG_MODE_MINIMAL=y

# Added by Gustaf #
# --------------- #
# CONFIG_NUM_PIPE_ASYNC_MSGS=10
CONFIG_KERNEL_MEM_POOL=y
CONFIG_HEAP_MEM_POOL_SIZE=16384


# CONFIG_ARCH_HAS_THREAD_LOCAL_STORAGE=y
CONFIG_MMU=y

CONFIG_KERNEL_VM_BASE=0x80000000
CONFIG_KERNEL_VM_OFFSET=0
CONFIG_KERNEL_VM_SIZE=0x800000

# CONFIG_LOG_MINIMAL=y
```
